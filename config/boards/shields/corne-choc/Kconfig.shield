## config/boards/shields/corne-choc/Kconfig.shield
```kconfig
# Copyright (c) 2020 Pete Johanson
# SPDX-License-Identifier: MIT

config SHIELD_CORNE-CHOC_LEFT
	def_bool $(shields_list_contains,corne-choc_left)

config SHIELD_CORNE-CHOC_RIGHT
	def_bool $(shields_list_contains,corne-choc_right)
```
